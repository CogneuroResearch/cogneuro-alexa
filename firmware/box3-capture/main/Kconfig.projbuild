## firmware/box3-capture/main/Kconfig.projbuild
```kconfig
menu "Capture firmware configuration"

    config CAPTURE_WIFI_SSID
        string "WiFi SSID"
        default "my-network"

    config CAPTURE_WIFI_PASSWORD
        string "WiFi password"
        default ""

    config CAPTURE_ENDPOINT
        string "Capture endpoint URL"
        default "https://cogneuro-alexa.vercel.app/api/capture"
        help
            Full URL of the ingest endpoint. Query parameters are appended by the firmware.

    config CAPTURE_DEVICE_KEY
        string "Device key"
        default ""
        help
            Must match DEVICE_KEY on the server. Sent as the X-Device-Key header.

    config CAPTURE_MAX_SECONDS
        int "Maximum seconds for one utterance"
        default 12
        range 1 60
        help
            A safety cap, not the normal length. Utterances end when you stop
            talking; this only bounds the buffer if endpointing never fires.

    config CAPTURE_TRAILING_SILENCE_MS
        int "Silence that ends an utterance (ms)"
        default 700
        range 200 3000
        help
            Shorter feels snappier but clips people who pause mid-sentence.
            Longer is safer and adds that long to every single turn.

    config CAPTURE_MIN_SPEECH_MS
        int "Minimum speech before an utterance can end (ms)"
        default 300
        range 0 3000
        help
            Without this floor a cough, or the click of the button itself,
            ends the utterance immediately and Whisper receives nothing.

    config CAPTURE_SAMPLE_RATE
        int "Sample rate (Hz)"
        default 16000

    config CAPTURE_MIC_CHANNELS
        int "Channels to read from the ES7210"
        default 2
        range 1 4
        help
            The BOX-3's ES7210 exposes two microphones plus two echo-reference
            channels. Two is the pair of mics. If captures come back silent or
            sound like noise, this is the first knob to try.

    config CAPTURE_MIC_GAIN_DB
        int "Microphone gain (dB)"
        default 30
        range 0 60

    config CAPTURE_ASSISTANT_MODE
        bool "Talk to the assistant instead of the review page"
        default n
        help
            Off: POST captures to the Vercel review page and play nothing.
            That is the input-inspection harness and it stays useful.

            On: POST to the Pi, which transcribes, thinks, and streams spoken
            audio back to be played through the speaker.

    config CAPTURE_ASSISTANT_ENDPOINT
        string "Assistant endpoint URL"
        depends on CAPTURE_ASSISTANT_MODE
        default "http://cogneuro-pi.local:8080/talk?stream=1"
        help
            The Pi's /talk endpoint. Keep stream=1: the reply is played as it
            arrives, so speech starts about two seconds in instead of after
            the whole answer has been synthesized.

            Resolving cogneuro-pi.local needs mDNS, which this firmware
            initialises. An IP address works too but will move unless the
            router has a DHCP reservation for the Pi.

    config CAPTURE_SPEAKER_VOLUME
        int "Speaker volume (percent)"
        depends on CAPTURE_ASSISTANT_MODE
        default 70
        range 0 100

    config CAPTURE_TRIGGER_WAKE_WORD
        bool "Trigger captures with the on-device wake word"
        default y
        help
            The AFE runs either way — it provides the beamforming and the voice
            activity detection that ends an utterance. This only controls
            whether a wake-word detection also starts a capture.

            Turn it off to fall back to button-only while keeping endpointing.

            Select which wake word under: ESP Speech Recognition -> WakeNet.

endmenu
```
